## conf/layer.conf
```bitbake
# We have a conf and classes directory, add to BBPATH
BBPATH .= ":${LAYERDIR}"

# We have recipes-* directories, add to BBFILES
BBFILES += "${LAYERDIR}/recipes-*/*/*.bb \
            ${LAYERDIR}/recipes-*/*/*.bbappend"

BBFILE_COLLECTIONS += "meta-icb"
BBFILE_PATTERN_meta-icb = "^${LAYERDIR}/"
BBFILE_PRIORITY_meta-icb = "6"

LAYERDEPENDS_meta-icb = "core"
LAYERSERIES_COMPAT_meta-icb = "warrior"

FSL_EULA_FILE = "${LAYERDIR}/EULA"
```

## conf/machine/imx6qdlicb.conf
```bitbake
#@TYPE: Machine
#@NAME: Naimtechnology i.MX6Q ICB
#@SOC: i.MX6Q
#@DESCRIPTION: Machine configuration for Naimtechnology i.MX6Q ICB
#@MAINTAINER: Hyuksoo KIM <kimhs@naimtechnology.com>
#
# This machine replaces the following machines:
#    * imx6qdl-icb
# and is able to work for all the machines.

MACHINEOVERRIDES =. "mx6:mx6q:mx6dl:"

require conf/machine/include/imx-base.inc
require conf/machine/include/tune-cortexa9.inc

KERNEL_DEVICETREE = "imx6q-sabresd.dtb"

KERNEL_DEVICETREE_use-mainline-bsp = "imx6q-icb.dtb"

UBOOT_MACHINE ?= "mx6icb_defconfig"

# Use fslc u-boot by default. See also imx-base.inc.
UBOOT_MAKE_TARGET = "all"
UBOOT_SUFFIX = "img"
SPL_BINARY = "SPL"
WKS_FILE = "imx-uboot-spl-bootpart.wks.in"

SERIAL_CONSOLES = "115200;ttymxc0"

MACHINE_FIRMWARE_append_mx6 = " linux-firmware-ath6k"

MACHINE_FEATURES += " pci wifi bluetooth"
```
